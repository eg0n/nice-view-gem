## boards/shields/nice_view_gem/Kconfig.defconfig
```kconfig
if SHIELD_NICE_VIEW_GEM

config LV_Z_VDB_SIZE
    default 100

config LV_DPI_DEF
    default 161

config LV_Z_BITS_PER_PIXEL
    default 1

choice LV_COLOR_DEPTH
    default LV_COLOR_DEPTH_1
endchoice

choice ZMK_DISPLAY_WORK_QUEUE
    default ZMK_DISPLAY_WORK_QUEUE_DEDICATED
endchoice

choice ZMK_DISPLAY_STATUS_SCREEN
    default ZMK_DISPLAY_STATUS_SCREEN_CUSTOM
endchoice

config LV_Z_MEM_POOL_SIZE
    default 8192 if ZMK_DISPLAY_STATUS_SCREEN_CUSTOM

config ZMK_DISPLAY_STATUS_SCREEN_CUSTOM
    imply NICE_VIEW_WIDGET_STATUS

config NICE_VIEW_GEM_WPM_FIXED_RANGE
    bool "Enable fixed range for WPM gauge/chart"
    default y

config NICE_VIEW_GEM_WPM_FIXED_RANGE_MAX
    int "Fixed range maximum for WPM gauge/chart"
    default 100

config NICE_VIEW_GEM_PERIPHERAL_STATUS
    bool "Show the peripheral's link on the central"
    depends on ZMK_SPLIT_ROLE_CENTRAL
    default y if ZMK_SPLIT_ESB
    help
      A row under the battery for the (first) peripheral: OFF while it is
      not linked, else the signal strength of its packets on ESB split
      (zmk-split-esb), or its battery level on BLE split (enable
      ZMK_SPLIT_BLE_CENTRAL_BATTERY_LEVEL_FETCHING).

config NICE_VIEW_GEM_LINK_STATS
    bool "Show ESB key latency on the peripheral"
    depends on ZMK_SPLIT_ESB && !ZMK_SPLIT_ROLE_CENTRAL
    default y
    help
      A row under the battery, LAT: the average time a key event waited
      for the central's ACK over the last second of typing.

config NICE_VIEW_GEM_ANIMATION
    bool "Enable animation on peripheral"
    default y

config NICE_VIEW_GEM_ANIMATION_FRAME
    int "Frame index (out of 16) to use if animation is disabled"
    default 0

config NICE_VIEW_GEM_ANIMATION_MS
    int "Animation length in milliseconds"
    default 960

config NICE_VIEW_WIDGET_STATUS
    select LV_USE_LABEL
    select LV_USE_IMAGE
    select LV_USE_CANVAS
    select LV_USE_ANIMIMG
    select LV_USE_ANIMATION

config NICE_VIEW_WIDGET_INVERTED
    bool "Invert display colors"

if !ZMK_SPLIT || ZMK_SPLIT_ROLE_CENTRAL

config NICE_VIEW_WIDGET_STATUS
    select ZMK_WPM

endif # !ZMK_SPLIT || ZMK_SPLIT_ROLE_CENTRAL

endif # SHIELD_NICE_VIEW_GEM
```
